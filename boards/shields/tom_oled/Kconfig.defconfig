## boards/shields/tom_oled/Kconfig.defconfig
```kconfig
# Copyright (c) 2024 The ZMK Contributors
# SPDX-License-Identifier: MIT

if SHIELD_TOM_OLED

choice ZMK_DISPLAY_STATUS_SCREEN
    default ZMK_DISPLAY_STATUS_SCREEN_CUSTOM
endchoice

config ZMK_DISPLAY_STATUS_SCREEN_CUSTOM
    select LV_USE_LABEL
    select LV_USE_IMAGE
    select LV_USE_CANVAS
    select LV_USE_ANIMIMG
    select LV_USE_ANIMATION
    select LV_USE_LINE
    select LV_FONT_UNSCII_8
    select ZMK_WPM if !ZMK_SPLIT || ZMK_SPLIT_ROLE_CENTRAL
    imply ZMK_HID_INDICATORS

config ZMK_TOM_OLED_CODEX_STATUS
    bool "Start central OLED in Agent status mode"
    default n
    depends on !ZMK_SPLIT || ZMK_SPLIT_ROLE_CENTRAL
    help
        Select the initial central OLED mode when there is no saved selection.
        y starts with AgentOLED and n starts with Bongo Cat. The oled_mode
        behavior switches between both modes at runtime.

config ZMK_TOM_OLED_CODEX_STATUS_STUDIO_RPC
    bool "Receive Agent status through ZMK Studio custom RPC"
    default y
    depends on ZMK_STUDIO_RPC
    help
        Register the tom_oled__codex_status custom subsystem used by AgentOLED.

config ZMK_TOM_OLED_CODEX_STATUS_DEFAULT_TTL_SEC
    int "Default Agent status timeout in seconds"
    default 120
    range 1 3600
    depends on ZMK_TOM_OLED_CODEX_STATUS_STUDIO_RPC

config ZMK_TOM_OLED_CODEX_STATUS_MAX_TTL_SEC
    int "Maximum Agent status timeout in seconds"
    default 3600
    range 1 65535
    depends on ZMK_TOM_OLED_CODEX_STATUS_STUDIO_RPC

config ZMK_TOM_OLED_AGENT_QUOTA_STUDIO_RPC
    bool "Receive AI quota through ZMK Studio custom RPC"
    default y
    depends on ZMK_STUDIO_RPC
    depends on !ZMK_SPLIT || ZMK_SPLIT_ROLE_CENTRAL
    help
      Register the tom_oled__agent_quota custom subsystem used by the
      full-screen AI quota mode.

config ZMK_TOM_OLED_AGENT_QUOTA_DEFAULT_TTL_SEC
    int "Default AI quota timeout in seconds"
    default 300
    range 1 65535
    depends on ZMK_TOM_OLED_AGENT_QUOTA_STUDIO_RPC

config ZMK_TOM_OLED_AGENT_QUOTA_MAX_TTL_SEC
    int "Maximum AI quota timeout in seconds"
    default 3600
    range 1 65535
    depends on ZMK_TOM_OLED_AGENT_QUOTA_STUDIO_RPC

config ZMK_TOM_OLED_DONGLE_BATTERY
    bool "Show also the battery level of the dongle"
    depends on BT && (!ZMK_SPLIT_BLE || ZMK_SPLIT_ROLE_CENTRAL)

config ZMK_TOM_OLED_MAC_MODIFIERS
    bool "Use MacOS modifier symbols instead of the Windows symbols"

config ZMK_TOM_OLED_BONGO_CAT
    bool "Display the Bongo Cat widget"
    default y

config ZMK_TOM_OLED_MODIFIERS
    bool "Display the modifiers widget"
    default y

config ZMK_TOM_OLED_LAYER
    bool "Display the highest layer widget"
    default y

config ZMK_TOM_OLED_LAYER_NAME_SCROLL_WIDTH
    int "Width for layer name label (in pixels)"
    default 50
    help
        Width in pixels for the layer name label. When the layer name
        exceeds this width, it will scroll horizontally in a circular pattern.

config ZMK_TOM_OLED_LAYER_TEXT_ALIGN
    string "Layer name text alignment"
    default "right"
    help
        Text alignment for the layer name label. Valid values: "left", "center", "right".

config ZMK_TOM_OLED_WPM
    bool "Display the WPM widget"
    default n

config ZMK_TOM_OLED_WPM_DISABLED_LAYERS
    string "Layers in which the widget is disabled, comma separated"
    default ""

choice ZMK_DISPLAY_WORK_QUEUE
    default ZMK_DISPLAY_WORK_QUEUE_DEDICATED
endchoice

config LV_Z_MEM_POOL_SIZE
    default 16384

config LV_Z_VDB_SIZE
    default 100

config LV_DPI_DEF
    default 148

config LV_Z_BITS_PER_PIXEL
    default 1

choice LV_COLOR_DEPTH
    default LV_COLOR_DEPTH_1
endchoice

endif
```
